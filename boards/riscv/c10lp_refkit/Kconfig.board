## boards/riscv/c10lp_refkit/Kconfig.board
```kconfig
config BOARD_C10LP_REFKIT
	bool "C10LP RefKit"
	depends on SOC_RISCV32_LITEX_VEXRISCV
```

## boards/riscv/c10lp_refkit/c10lp_refkit_defconfig
```kconfig
# Board and SoC definition
CONFIG_SOC_RISCV32_LITEX_VEXRISCV=y
CONFIG_BOARD_C10LP_REFKIT=y

# Set clock frequency
CONFIG_SYS_CLOCK_HW_CYCLES_PER_SEC=50000000

CONFIG_VEXRISCV_LITEX_IRQ=y
CONFIG_LITEX_TIMER=y
CONFIG_CONSOLE=y
CONFIG_SERIAL=y
CONFIG_UART_LITEUART=y
CONFIG_UART_CONSOLE=y
CONFIG_HWINFO=y
CONFIG_HWINFO_LITEX=y
CONFIG_XIP=n
```
